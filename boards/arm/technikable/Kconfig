## boards/arm/technikable/Kconfig
```kconfig
# SPDX-License-Identifier: MIT

config BOARD_ENABLE_DCDC
	bool "Enable DCDC mode"
	select SOC_DCDC_NRF52X
	default y
	depends on BOARD_TECHNIKABLE

# Setting to reset bluetooth status
# CONFIG_ZMK_BLE_CLEAR_BONDS_ON_START=y
```
